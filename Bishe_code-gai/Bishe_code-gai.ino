#include <SoftwareSerial.h>//蓝牙软串口库
#include <LobotServoController.h>//调用舵机控制器库
#include <SPI.h>
#include <Wire.h>
#include <Adafruit_GFX.h>
#include <Adafruit_SSD1306.h>//以上四个库为OLED库，SCL接A5，SDA接A4
#include "FastLED.h"            // 此示例程序需要使用FastLED库

const int trigPin = 10;
const int echoPin = 9;
long duration;
int distanceCm;//超声波初始化

#define NUM_LEDS 8             // LED灯珠数量
#define LED_DT 6                // Arduino输出控制信号引脚
#define LED_TYPE WS2812         // LED灯带型号
#define COLOR_ORDER RGB         // RGB灯珠中红色、绿色、蓝色LED的排列顺序
uint8_t max_bright = 128;       // LED亮度控制变量，可使用数值为 0 ～ 255， 数值越大则光带亮度越高
CRGB leds[NUM_LEDS];            // 建立光带leds
uint8_t beginHue;
//定义RGB初始化
LobotServoController myse;//舵机控制器初始化

SoftwareSerial BTserial(2, 3);//将数字2，3引脚作为蓝牙模块引脚，TX连2，RX连3，RX需分压至3.3v        

#define OLED_RESET 4
Adafruit_SSD1306 display(OLED_RESET);
#if (SSD1306_LCDHEIGHT != 64)
#error("Height incorrect, please fix Adafruit_SSD1306.h!");
int sensorValue = 0;
int voltage = 0;
const int analogInPin = A0;
#endif//OLED初始化，下方为字模内容
#define QKFWOQ_BMPWIDTH  128
const unsigned char bitmap_ddsmc[] PROGMEM = {
  0x00,0x00,0x00,0x00,0x00,0x00,0x00,0x00,0x00,0x00,0x00,0x00,0x00,0x00,0x00,0x00, // ................................................................................................................................
  0x00,0x00,0x00,0x00,0x00,0x00,0x00,0x00,0x00,0x00,0x00,0x00,0x00,0x00,0x00,0x00, // ................................................................................................................................
  0x00,0x00,0x1E,0x00,0x00,0x00,0x00,0x00,0x00,0x00,0x00,0x00,0x00,0x00,0x00,0x00, // ...................####.........................................................................................................
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  0x00,0x00,0x00,0x00,0x00,0x00,0x00,0x00,0x00,0x00,0x00,0x00,0x00,0x00,0x00,0x00  // ................................................................................................................................
};//前进中。。。
const unsigned char bitmap_g1ldrm[] PROGMEM = {
  0x00,0x00,0x00,0x00,0x00,0x00,0x00,0x00,0x00,0x00,0x00,0x00,0x00,0x00,0x00,0x00, // ................................................................................................................................
  0x00,0x00,0x00,0x00,0x00,0x00,0x00,0x00,0x00,0x00,0x00,0x00,0x00,0x00,0x00,0x00, // ................................................................................................................................
  0x00,0x00,0x00,0x00,0x00,0x00,0x00,0x00,0x00,0x00,0x00,0x00,0x00,0x00,0x00,0x00, // ................................................................................................................................
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  0x00,0x00,0x00,0x00,0x00,0x00,0x00,0x00,0x00,0x00,0x00,0x00,0x00,0x00,0x00,0x00  // ................................................................................................................................
};//欢迎使用
const unsigned char bitmap_8ka9jq[] PROGMEM = {
  0x00,0x00,0x00,0x00,0x00,0x00,0x00,0x00,0x00,0x00,0x00,0x00,0x00,0x00,0x00,0x00, // ................................................................................................................................
  0x00,0x00,0x00,0x00,0x00,0x00,0x00,0x00,0x00,0x00,0x00,0x00,0x00,0x00,0x00,0x00, // ................................................................................................................................
  0x00,0x00,0x00,0x00,0x00,0x00,0x00,0x00,0x00,0x00,0x00,0x00,0x00,0x00,0x00,0xFF, // ........................................................................................................................########
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  0x00,0x00,0x00,0x00,0x00,0x00,0x00,0x00,0x00,0x00,0x00,0x00,0x00,0x00,0x00,0x00  // ................................................................................................................................
};//控制模式
const unsigned char bitmap_954w2u[] PROGMEM = {
  0x00,0x00,0x00,0x00,0x00,0x00,0x00,0x00,0x00,0x00,0x00,0x00,0x00,0x00,0x00,0x00, // ................................................................................................................................
  0x00,0x00,0x00,0x00,0x00,0x00,0x00,0x00,0x00,0x00,0x00,0x02,0x00,0x00,0x00,0x00, // ..............................................................................................#.................................
  0x00,0x00,0x00,0x00,0x00,0x00,0x00,0x00,0x00,0x00,0x00,0x07,0x80,0x00,0x00,0x00, // .............................................................................................####...............................
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  0x00,0x00,0x00,0x00,0x00,0x00,0x01,0x00,0x00,0x00,0x00,0x00,0x00,0x00,0x00,0x00  // .......................................................#........................................................................
};//点手1
const unsigned char bitmap_lre86w[] PROGMEM = {
  0x00,0x00,0x00,0x00,0x00,0x00,0x00,0x00,0x00,0x00,0x00,0x00,0x00,0x00,0x00,0x00, // ................................................................................................................................
  0x00,0x00,0x00,0x00,0x00,0x00,0x00,0x00,0x00,0x00,0x00,0x02,0x00,0x00,0x00,0x00, // ..............................................................................................#.................................
  0x00,0x00,0x00,0x00,0x00,0x00,0x00,0x00,0x00,0x00,0x00,0x07,0x80,0x00,0x00,0x00, // .............................................................................................####...............................
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  0x00,0x00,0x00,0x00,0x00,0x00,0x00,0x08,0x00,0x00,0x00,0x00,0x00,0x00,0x00,0x00  // ............................................................#...................................................................
};//点手2
const unsigned char bitmap_c9e2yn[] PROGMEM = {
  0x00,0x00,0x00,0x00,0x00,0x00,0x00,0x00,0x00,0x00,0x00,0x00,0x00,0x00,0x00,0x00, // ................................................................................................................................
  0x00,0x00,0x00,0x00,0x00,0x00,0x00,0x00,0x00,0x00,0x00,0x00,0x00,0x00,0x00,0x00, // ................................................................................................................................
  0x00,0x00,0x00,0x00,0x00,0x0F,0x80,0x00,0x00,0x00,0x00,0x00,0x00,0x00,0x00,0x00, // ............................................#####...............................................................................
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  0x00,0x00,0x00,0x00,0x00,0x00,0x00,0x00,0x00,0x00,0x00,0x00,0x00,0x00,0x00,0x00  // ................................................................................................................................
};//I'm MIMIC
const unsigned char bitmap_6x51mr[] PROGMEM = {
  0x00,0x00,0x00,0x00,0x00,0x00,0x00,0x00,0x00,0x00,0x00,0x00,0x00,0x00,0x00,0x00, // ................................................................................................................................
  0x00,0x00,0x00,0x00,0x80,0x00,0x00,0x00,0x00,0x00,0x00,0x00,0x00,0x00,0x00,0x00, // ................................#...............................................................................................
  0x00,0x00,0x00,0x00,0xC0,0x00,0x00,0x00,0x00,0x00,0x00,0x00,0x00,0x00,0x00,0x00, // ................................##..............................................................................................
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  0x00,0x00,0x00,0x00,0x00,0x00,0x00,0x00,0x00,0x00,0x00,0x00,0x00,0x00,0x00,0x00  // ................................................................................................................................
};//避障中
const unsigned char bitmap_gt0ik[] PROGMEM = {
  0x00,0x00,0x00,0x00,0x00,0x00,0x00,0x00,0x00,0x00,0x00,0x00,0x00,0x00,0x00,0x00, // ................................................................................................................................
  0x00,0x00,0x00,0x00,0x00,0x00,0x00,0x00,0x00,0x00,0x00,0x00,0x00,0x00,0x00,0x00, // ................................................................................................................................
  0x00,0x00,0x00,0x00,0x00,0x00,0x00,0x00,0x00,0x00,0x00,0x18,0x00,0x00,0x00,0x00, // ...........................................................................................##...................................
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  0x00,0x00,0x00,0x00,0x00,0x00,0x00,0x00,0xE0,0x00,0x00,0x00,0x00,0x00,0x00,0x02  // ................................................................###...........................................................#.
};//思考中
const unsigned char bitmap_shpxw7[] PROGMEM = {
  0x00,0x00,0x00,0x00,0x00,0x00,0x00,0x00,0x60,0x00,0x00,0x00,0x00,0x00,0x00,0x00, // .................................................................##.............................................................
  0x00,0x03,0x00,0x00,0x00,0x00,0x00,0x00,0x60,0x00,0x00,0x00,0x00,0x00,0x00,0x00, // ..............##.................................................##.............................................................
  0x00,0x03,0x00,0x00,0x00,0x00,0x00,0x00,0x60,0x00,0x00,0x00,0x00,0x00,0x00,0x00, // ..............##.................................................##.............................................................
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  0x00,0x00,0x00,0x00,0x00,0x00,0x00,0x00,0x00,0x00,0x00,0x00,0x00,0x00,0x00,0x00  // ................................................................................................................................
};//立正中
//以下是定义一些常量
int LF1 = 4;
int LF2 = 7;
int RF1 = 11;
int RF2 = 8;
int LB1 = 3;
int LB2 = 0;
int RB1 = 12;
int RB2 = 15;//以上为八个舵机对应的舵机控制器引脚
int STBpos = 1500;//臂初始角度90。
int STFpos1 = 2000;//足初始角度(LF2和RB2)135。
int STFpos2 = 1000;//足初始角度（RF2和LB2)45。
int Fstep = 250;//定义前进过程中每个动作之间的时间间隔0.25s
int pos0 = 500;
int pos45 = 1000;
int pos67 = 1250;
int pos75 = 1333;
int pos90 = 1500;
int pos105 = 1666;
int pos112 = 1750;
int pos135 = 2000;
int pos150 = 2166;
int pos180 = 2500;//角度转换定义
int mindistance = 10;//定义自主转向最小距离
bool Mode = 1;
bool StMode = 1;
void setup() 
{
  pinMode(13,OUTPUT);//设置13号引脚为输出模式
  Serial.begin(9600);//设置波特率9600
  BTserial.begin(9600);//蓝牙模块波特率设置为9600
  while(!Serial);//等待串口即舵机控制板通信成功再往下执行程序
  digitalWrite(13,HIGH);//arduino的LED亮起
  pinMode(5,OUTPUT);
  pinMode(4,INPUT);//设置超声波引脚
  LEDS.addLeds<LED_TYPE, LED_DT, COLOR_ORDER>(leds, NUM_LEDS);  // 初始化光环
  FastLED.setBrightness(max_bright);                           // 设置光环灯珠亮度
  display.begin(SSD1306_SWITCHCAPVCC, 0x3C);  // 将 I2C 地址初始化为 0x3C（用于 128x64 显示器）
  display.clearDisplay(); // 在启动程序之前清除显示以避免adafruit闪屏
  display.drawBitmap(0, 0, bitmap_g1ldrm, 128, 64, WHITE);//加载图片‘欢迎使用’
  display.display();
  delay(1000);
  display.clearDisplay(); // 在启动程序之前清除显示以避免adafruit闪屏
  display.drawBitmap(0, 0, bitmap_c9e2yn, 128, 64, WHITE);//加载图片‘I'm MIMIC’
  display.display();
  delay(2000);
}

void loop() { 
  digitalWrite(trigPin, LOW);
  delayMicroseconds(2);
  digitalWrite(trigPin, HIGH);
  delayMicroseconds(10);
  digitalWrite(trigPin, LOW);
  duration = pulseIn(echoPin, HIGH);
  distanceCm = duration * 0.034 / 2;//开启超声波测距并且获得距离
  if( BTserial.available())
  {
    char BTCMD = BTserial.read();//将软件串口中的数据赋值给变量BTCMD
    if (Mode == 1)//判断指令并且进入手动控制模式
    {controlMode(BTCMD);
    delay(50);
    }
    else {
    AutoModswitch(BTCMD);
    delay(50);
    }
  }
if(Mode == 0)
{ FastLED.setBrightness(max_bright);
  float Nowdistance = distanceCm;
  if (Nowdistance < mindistance)
    {
    fill_solid(leds, 8, CRGB::Yellow);
    FastLED.show();
    display.clearDisplay();
    display.drawBitmap(0, 0, bitmap_6x51mr, 128, 64, WHITE);
    display.display();//加载图片‘避障中。。。’
    delay(40);
    myse.stopActionGroup();
    myse.runActionGroup(4,1);
    delay(1000);
    }//若距离大于预定则持续往前走
    else
    {
    fill_solid(leds, 8, CRGB::Snow);
    FastLED.show();
    display.clearDisplay();
    display.drawBitmap(0, 0, bitmap_ddsmc, 128, 64, WHITE);
    display.display();//加载图片‘前进中...’
    delay(40);
    myse.stopActionGroup();
    myse.runActionGroup(8,1);
    delay(1000);
    }//若小于预定值则左转转向
}
else 
{ if(StMode == 1)
  {NoactionMode();
}
else
{
  JuststayMode();
}
}
}
void controlMode(char BTCMD)//手动控制模式函数
{ 
  display.clearDisplay();
  display.drawBitmap(0, 0, bitmap_8ka9jq, 128, 64, WHITE);
  display.display();//加载图片‘控制模式’
  switch(BTCMD)
  {
  case 'w':  // 前进
  myse.stopActionGroup();
  myse.runActionGroup(8,1);
  delay(500);
  break;
  case 'a':
  myse.stopActionGroup();
  myse.runActionGroup(4,1);//执行左转指令一次
  delay(500);
  break;
  case 'd':
  myse.stopActionGroup();
  myse.runActionGroup(6,1);//执行右转指令一次
  delay(500);
  break;
  case 'q':
  myse.stopActionGroup();
  myse.runActionGroup(7,1);//执行左挥手指令一次
  delay(500);
  break;
  case 'e':
  myse.stopActionGroup();
  myse.runActionGroup(9,1);//执行右挥手指令一次
  delay(500);
  break;
  case 'f':
  myse.stopActionGroup();
  myse.runActionGroup(88,10);//开启不断前进模式
  delay(500);
  break;
  case 's':
  myse.stopActionGroup();//停止不断前进
  display.clearDisplay(); // 在启动程序之前清除显示以避免adafruit闪屏
  display.drawBitmap(0, 0, bitmap_gt0ik, 128, 64, WHITE);//加载图片‘思考中’
  display.display();
  delay(5000);
  break;
  case 'j':
  StMode = 0;
  break;
  case 'J':
  StMode = 1;
  break;
  case 'A':
  Mode = 0;//切换为自主模式
  delay(500);
  default:
  break;
}
delay(500);
for(int i=0;i<max_bright;i=i+3)
{
  FastLED.setBrightness(i); 
  fill_solid(leds, 8, CRGB::Snow);
  FastLED.show();
  delay(20);
}
for(int i=max_bright;i>0;i=i-3)
{
  FastLED.setBrightness(i); 
  fill_solid(leds, 8, CRGB::Snow);
  FastLED.show();
  delay(20);
}//白色呼吸灯效果
}
void NoactionMode()
{ 
  display.clearDisplay(); // 在启动程序之前清除显示以避免adafruit闪屏
  display.drawBitmap(0, 0, bitmap_954w2u, 128, 64, WHITE);
  display.display();
  delay(50);
  display.clearDisplay();
  display.drawBitmap(0, 0, bitmap_lre86w, 128, 64, WHITE);
  display.display();//等待指令
  delay(50);
  FastLED.setBrightness(max_bright);
  beginHue=beginHue+8;   
  fill_rainbow(leds, NUM_LEDS, beginHue, 16); 
  FastLED.show();//RGB展示
  myse.runActionGroup(18,1);//如果无指令将会不断执行摆臂动作
}
void AutoModswitch(char BTCMD)
{
  if(BTCMD = 'C')
  {
    Mode = 1;
    delay(500);
  }
}
void JuststayMode()
{ display.clearDisplay();
  display.drawBitmap(0, 0, bitmap_shpxw7, 128, 64, WHITE);
  display.display();//立正中
  myse.stopActionGroup();
  myse.moveServos(8,2000,LF1,STBpos,LB1,STBpos,RF1,STBpos,RB1,STBpos,LF2,STFpos1,RB2,STFpos1,RF2,STFpos2,LB2,STFpos2);//初始姿态
  for(int i=0;i<max_bright;i=i+3)
{
  FastLED.setBrightness(i); 
  fill_solid(leds, 8, CRGB::Blue);
  FastLED.show();
  delay(20);
}
for(int i=max_bright;i>0;i=i-3)
{ 
  FastLED.setBrightness(i); 
  fill_solid(leds, 8, CRGB::Blue);
  FastLED.show();
  delay(20);
}//蓝色呼吸灯效果
  delay(50);
}